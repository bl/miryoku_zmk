// Copyright 2021 Manna Harbour
// https://github.com/manna-harbour/miryoku

#include "custom/timeless_homerow_mods.dtsi"
#include "../miryoku/custom_config.h"
#include "../miryoku/mapping/42/corne.h"
#include "../miryoku/miryoku.dtsi"
